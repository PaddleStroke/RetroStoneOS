## buildroot-external/Config.in
```kconfig
config BR2_RETROSTONE_DTS_DIR
	string "RetroStone device tree source directory"
	help
	  Directory holding the board's .dts, named as the first entry of
	  BR2_LINUX_KERNEL_INTREE_DTS_NAME (sun7i-a20-retrostone2.dts,
	  sun8i-h3-retrostone1.dts), plus any .dtsi it includes, and
	  overlays/*.dtso. They are copied into the kernel's
	  arch/arm/boot/dts/allwinner/ before the kernel is built (see
	  external.mk). Normally
	  $(BR2_EXTERNAL_RETROSTONE_PATH)/board/<board>/dts.

menu "RetroStoneOS build"

config BR2_RETROSTONE_RELEASE
	bool "Release build"
	help
	  Build a release image instead of a development image
	  (docs/build.md, "Release build"; retrostone2_release_defconfig
	  sets it):
	  - boot.scr without "initcall_debug log_buf_len=1M" (RetroStone2);
	  - the boot logger is light: one copy of the logs when the menu
	    is up, one 10 s later, then every 10 minutes for an hour
	    (rsos/logs/verbose on the card restores the development
	    cadence, rsos/logs/disabled turns it off);
	  - the shell on the debug UART stays open by default, as in
	    development builds (below: a password or no shell are options);
	  - no "-dev" in the version string.
	  The release defconfig also makes U-Boot ignore the UART
	  (bootdelay -2: board/retrostone2/uboot-release.fragment).

config BR2_RETROSTONE_VERSION
	string "OS version"
	help
	  The version this image reports (/etc/rsos-version, and
	  /etc/rsos/version.env for the system updater, which compares it
	  with the updates it finds: docs/updates.md), e.g. "0.2.0".
	  Empty: the rsos-frontend package's version. CI sets it from the
	  release tag (v0.2.0 -> 0.2.0; scripts/ci/build-board.sh).
	  Development builds get "-dev" appended.

choice
	prompt "Shell on the debug UART"
	default BR2_RETROSTONE_UART_SHELL_OPEN
	help
	  What init starts on the debug UART (board.ini serial_console,
	  ttyS0 by default). Open by default in both development and
	  release builds (owner's decision 2026-09-27: reaching the UART
	  needs a cable and opening the case).

config BR2_RETROSTONE_UART_SHELL_OPEN
	bool "open: root shell, no login"

config BR2_RETROSTONE_UART_SHELL_PASSWORD
	bool "root login with a password"
	select BR2_PACKAGE_HOST_MKPASSWD

config BR2_RETROSTONE_UART_SHELL_DISABLED
	bool "disabled: nothing on the UART"

endchoice

config BR2_RETROSTONE_UART_PASSWORD
	string "Root password for the UART login"
	depends on BR2_RETROSTONE_UART_SHELL_PASSWORD
	default "CHANGE-ME"
	help
	  The root password (stored hashed, SHA-512, in /etc/shadow). The
	  build stops while it is still the placeholder "CHANGE-ME": set
	  your own with menuconfig, or with
	    sed -i 's/^BR2_RETROSTONE_UART_PASSWORD=.*/BR2_RETROSTONE_UART_PASSWORD="..."/' .config
	  in the output directory. No double quotes in the password.

endmenu

menu "RetroStoneOS packages"

# Buildroot 2026.02 still ships the Linux 4.x kconfig: it has neither
# "osource" nor wildcards in "source", so every package Config.in must be
# listed by hand (external.mk picks up the .mk files automatically):
#   source "$BR2_EXTERNAL_RETROSTONE_PATH/package/rsos-frontend/Config.in"
# The libretro cores are grouped in package/libretro-cores.Config.in.

source "$BR2_EXTERNAL_RETROSTONE_PATH/package/rsos-frontend/Config.in"
source "$BR2_EXTERNAL_RETROSTONE_PATH/package/libretro-cores.Config.in"
source "$BR2_EXTERNAL_RETROSTONE_PATH/package/rsos-homebrew/Config.in"
source "$BR2_EXTERNAL_RETROSTONE_PATH/package/rsos-vc-games/Config.in"

endmenu
```

## buildroot-external/package/libretro-beetle-ngp/Config.in
```kconfig
config BR2_PACKAGE_LIBRETRO_BEETLE_NGP
	bool "libretro-beetle-ngp"
	depends on BR2_PACKAGE_RSOS_LIBRETRO_ARCH_SUPPORTS # package/libretro-common.mk
	depends on BR2_INSTALL_LIBSTDCPP
	depends on !BR2_STATIC_LIBS # shared object loaded with dlopen()
	help
	  Beetle NeoPop: Mednafen's Neo Geo Pocket / Neo Geo Pocket Color
	  emulator, built as a libretro core (GPL-2.0+). No BIOS needed.

	  Installs /usr/lib/libretro/mednafen_ngp_libretro.so and
	  /usr/share/rsos/cores/mednafen_ngp.ini.

	  https://github.com/libretro/beetle-ngp-libretro

comment "libretro-beetle-ngp needs a toolchain w/ C++, dynamic library"
	depends on BR2_PACKAGE_RSOS_LIBRETRO_ARCH_SUPPORTS
	depends on !BR2_INSTALL_LIBSTDCPP || BR2_STATIC_LIBS
```

## buildroot-external/package/libretro-beetle-pce-fast/Config.in
```kconfig
config BR2_PACKAGE_LIBRETRO_BEETLE_PCE_FAST
	bool "libretro-beetle-pce-fast"
	depends on BR2_PACKAGE_RSOS_LIBRETRO_ARCH_SUPPORTS # package/libretro-common.mk
	depends on BR2_INSTALL_LIBSTDCPP # linked with g++ (libstdc++ NEEDED)
	depends on !BR2_STATIC_LIBS # shared object loaded with dlopen()
	help
	  Beetle PCE Fast: Mednafen's fast PC Engine / TurboGrafx-16 /
	  PC Engine CD emulator, built as a libretro core (GPL-2.0+).
	  CD games need the syscard3.pce BIOS.

	  Installs /usr/lib/libretro/mednafen_pce_fast_libretro.so and
	  /usr/share/rsos/cores/mednafen_pce_fast.ini.

	  https://github.com/libretro/beetle-pce-fast-libretro

comment "libretro-beetle-pce-fast needs a toolchain w/ C++, dynamic library"
	depends on BR2_PACKAGE_RSOS_LIBRETRO_ARCH_SUPPORTS
	depends on !BR2_INSTALL_LIBSTDCPP || BR2_STATIC_LIBS
```

## buildroot-external/package/libretro-beetle-supafaust/Config.in
```kconfig
config BR2_PACKAGE_LIBRETRO_BEETLE_SUPAFAUST
	bool "libretro-beetle-supafaust (experimental)"
	depends on (BR2_arm && BR2_ARM_EABIHF) || BR2_PACKAGE_RSOS_LIBRETRO_ARCH_SUPPORTS
	depends on BR2_INSTALL_LIBSTDCPP
	depends on BR2_TOOLCHAIN_HAS_THREADS_NPTL # PPU thread, pthread_setaffinity_np()
	depends on !BR2_STATIC_LIBS # shared object loaded with dlopen()
	help
	  Beetle Supafaust: Mednafen's snes_faust SNES emulator with its
	  PPU rendered on a second thread, built as a libretro core
	  (GPL-2.0+). Experimental licence-clean alternative to the
	  snes9x cores: needs both A20 cores, and SuperFX/SA-1/CX4
	  games are expected below full speed.

	  Installs /usr/lib/libretro/mednafen_supafaust_libretro.so and
	  /usr/share/rsos/cores/mednafen_supafaust.ini.

	  https://github.com/libretro/supafaust

comment "libretro-beetle-supafaust needs a toolchain w/ C++, NPTL, dynamic library"
	depends on (BR2_arm && BR2_ARM_EABIHF) || BR2_PACKAGE_RSOS_LIBRETRO_ARCH_SUPPORTS
	depends on !BR2_INSTALL_LIBSTDCPP || !BR2_TOOLCHAIN_HAS_THREADS_NPTL || \
		BR2_STATIC_LIBS
```

## buildroot-external/package/libretro-beetle-supergrafx/Config.in
```kconfig
config BR2_PACKAGE_LIBRETRO_BEETLE_SUPERGRAFX
	bool "libretro-beetle-supergrafx"
	depends on BR2_PACKAGE_RSOS_LIBRETRO_ARCH_SUPPORTS # package/libretro-common.mk
	depends on BR2_INSTALL_LIBSTDCPP
	depends on !BR2_STATIC_LIBS # shared object loaded with dlopen()
	help
	  Beetle SuperGrafx (Mednafen "pce_fast" with SuperGrafx
	  support): PC Engine SuperGrafx (.sgx), and also PC Engine
	  HuCards and CD games, built as a libretro core.

	  Installs /usr/lib/libretro/mednafen_supergrafx_libretro.so
	  and /usr/share/rsos/cores/mednafen_supergrafx.ini. ROM
	  folder: supergrafx.

	  https://github.com/libretro/beetle-supergrafx-libretro

comment "libretro-beetle-supergrafx needs a toolchain w/ C++, dynamic library"
	depends on BR2_PACKAGE_RSOS_LIBRETRO_ARCH_SUPPORTS
	depends on !BR2_INSTALL_LIBSTDCPP || BR2_STATIC_LIBS
```

## buildroot-external/package/libretro-beetle-wswan/Config.in
```kconfig
config BR2_PACKAGE_LIBRETRO_BEETLE_WSWAN
	bool "libretro-beetle-wswan"
	depends on BR2_PACKAGE_RSOS_LIBRETRO_ARCH_SUPPORTS # package/libretro-common.mk
	depends on !BR2_STATIC_LIBS # shared object loaded with dlopen()
	help
	  Beetle Cygne: Mednafen's WonderSwan / WonderSwan Color / Pocket
	  Challenge V2 emulator, built as a libretro core (GPL-2.0+).
	  No BIOS needed.

	  Installs /usr/lib/libretro/mednafen_wswan_libretro.so and
	  /usr/share/rsos/cores/mednafen_wswan.ini.

	  https://github.com/libretro/beetle-wswan-libretro

comment "libretro-beetle-wswan needs a toolchain w/ dynamic library"
	depends on BR2_PACKAGE_RSOS_LIBRETRO_ARCH_SUPPORTS
	depends on BR2_STATIC_LIBS
```

## buildroot-external/package/libretro-bluemsx/Config.in
```kconfig
config BR2_PACKAGE_LIBRETRO_BLUEMSX
	bool "libretro-bluemsx"
	depends on BR2_PACKAGE_RSOS_LIBRETRO_ARCH_SUPPORTS # package/libretro-common.mk
	depends on BR2_INSTALL_LIBSTDCPP
	depends on !BR2_STATIC_LIBS # shared object loaded with dlopen()
	help
	  blueMSX: MSX / MSX2 / MSX2+ / turbo R emulator, built as a
	  libretro core (zlib-style licence with GPL-2.0+ parts). Ships
	  the free C-BIOS replacement BIOS, so cartridges run without
	  the original MSX system ROMs.

	  Installs /usr/lib/libretro/bluemsx_libretro.so,
	  /usr/share/rsos/cores/bluemsx.ini and the machine definitions
	  and databases in /usr/share/rsos/cores/bluemsx/.

	  https://github.com/libretro/blueMSX-libretro

comment "libretro-bluemsx needs a toolchain w/ C++, dynamic library"
	depends on BR2_PACKAGE_RSOS_LIBRETRO_ARCH_SUPPORTS
	depends on !BR2_INSTALL_LIBSTDCPP || BR2_STATIC_LIBS
```

## buildroot-external/package/libretro-cap32/Config.in
```kconfig
config BR2_PACKAGE_LIBRETRO_CAP32
	bool "libretro-cap32"
	depends on BR2_PACKAGE_RSOS_LIBRETRO_ARCH_SUPPORTS # package/libretro-common.mk
	depends on !BR2_STATIC_LIBS # shared object loaded with dlopen()
	help
	  Caprice32: Amstrad CPC 464/664/6128/6128+ emulator, built as a
	  libretro core. The CPC ROMs are built in (Amstrad allows their
	  distribution with emulators). Has its own on-screen keyboard.

	  Installs /usr/lib/libretro/cap32_libretro.so and
	  /usr/share/rsos/cores/cap32.ini. ROM folder: amstradcpc.

	  https://github.com/libretro/libretro-cap32
```

## buildroot-external/package/libretro-clownmdemu/Config.in
```kconfig
config BR2_PACKAGE_LIBRETRO_CLOWNMDEMU
	bool "libretro-clownmdemu (experimental)"
	depends on (BR2_arm && BR2_ARM_EABIHF) || BR2_PACKAGE_RSOS_LIBRETRO_ARCH_SUPPORTS
	depends on !BR2_STATIC_LIBS # shared object loaded with dlopen()
	help
	  ClownMDEmu: Sega Mega Drive / Genesis and Mega-CD / Sega CD
	  emulator, built as a libretro core (AGPL-3.0+). Experimental
	  licence-clean alternative to picodrive: an interpreter with no
	  dynarec, speed on the 1 GHz A20 not measured yet. Needs no
	  BIOS, also for Mega-CD.

	  Installs /usr/lib/libretro/clownmdemu_libretro.so and
	  /usr/share/rsos/cores/clownmdemu.ini.

	  https://github.com/Clownacy/clownmdemu-libretro

comment "libretro-clownmdemu needs a toolchain w/ dynamic library"
	depends on (BR2_arm && BR2_ARM_EABIHF) || BR2_PACKAGE_RSOS_LIBRETRO_ARCH_SUPPORTS
	depends on BR2_STATIC_LIBS
```

## buildroot-external/package/libretro-dosbox-pure/Config.in
```kconfig
config BR2_PACKAGE_LIBRETRO_DOSBOX_PURE
	bool "libretro-dosbox-pure"
	depends on BR2_PACKAGE_RSOS_LIBRETRO_ARCH_SUPPORTS # package/libretro-common.mk
	depends on BR2_INSTALL_LIBSTDCPP
	depends on BR2_TOOLCHAIN_HAS_THREADS
	depends on !BR2_STATIC_LIBS # shared object loaded with dlopen()
	help
	  DOSBox Pure: DOSBox for libretro, built for playing games. It
	  starts games straight from a .zip, maps the gamepad to the
	  keyboard/mouse, and has its own on-screen keyboard. Uses the
	  DOSBox dynamic recompiler on ARMv7, AArch64 and x86_64.

	  Installs /usr/lib/libretro/dosbox_pure_libretro.so and
	  /usr/share/rsos/cores/dosbox_pure.ini. ROM folder: dos.

	  https://github.com/schellingb/dosbox-pure

comment "libretro-dosbox-pure needs a toolchain w/ C++, threads, dynamic library"
	depends on BR2_PACKAGE_RSOS_LIBRETRO_ARCH_SUPPORTS
	depends on !BR2_INSTALL_LIBSTDCPP || !BR2_TOOLCHAIN_HAS_THREADS || \
		BR2_STATIC_LIBS
```

## buildroot-external/package/libretro-fake08/Config.in
```kconfig
config BR2_PACKAGE_LIBRETRO_FAKE08
	bool "libretro-fake08"
	depends on BR2_PACKAGE_RSOS_LIBRETRO_ARCH_SUPPORTS # package/libretro-common.mk
	depends on BR2_INSTALL_LIBSTDCPP
	depends on BR2_TOOLCHAIN_GCC_AT_LEAST_8 # -std=gnu++17
	depends on !BR2_STATIC_LIBS # shared object loaded with dlopen()
	help
	  FAKE-08: an open-source (MIT) PICO-8 cart player, built as a
	  libretro core. Runs .p8 and .p8.png carts; it is not related
	  to Lexaloffle's official PICO-8.

	  Installs /usr/lib/libretro/fake08_libretro.so and
	  /usr/share/rsos/cores/fake08.ini. ROM folder: pico8.

	  https://github.com/jtothebell/fake-08

comment "libretro-fake08 needs a toolchain w/ C++, gcc >= 8, dynamic library"
	depends on BR2_PACKAGE_RSOS_LIBRETRO_ARCH_SUPPORTS
	depends on !BR2_INSTALL_LIBSTDCPP || !BR2_TOOLCHAIN_GCC_AT_LEAST_8 || \
		BR2_STATIC_LIBS
```

## buildroot-external/package/libretro-fbneo/Config.in
```kconfig
config BR2_PACKAGE_LIBRETRO_FBNEO
	bool "libretro-fbneo"
	depends on BR2_PACKAGE_RSOS_LIBRETRO_ARCH_SUPPORTS # package/libretro-common.mk
	depends on BR2_INSTALL_LIBSTDCPP
	depends on BR2_TOOLCHAIN_HAS_THREADS
	depends on !BR2_STATIC_LIBS # shared object loaded with dlopen()
	help
	  FinalBurn Neo: arcade emulator (Neo Geo, CPS-1/2, Toaplan,
	  Cave, Konami, Sega System 16/18...) plus a few consoles, built
	  as a libretro core with the Cyclone ARM 68000 core. Uses the
	  current FBNeo romsets. Large: about 59 MB once stripped, and a
	  few minutes of build time.

	  Installs /usr/lib/libretro/fbneo_libretro.so and
	  /usr/share/rsos/cores/fbneo.ini.

	  https://github.com/libretro/FBNeo

comment "libretro-fbneo needs a toolchain w/ C++, threads, dynamic library"
	depends on BR2_PACKAGE_RSOS_LIBRETRO_ARCH_SUPPORTS
	depends on !BR2_INSTALL_LIBSTDCPP || !BR2_TOOLCHAIN_HAS_THREADS || \
		BR2_STATIC_LIBS
```

## buildroot-external/package/libretro-fceumm/Config.in
```kconfig
config BR2_PACKAGE_LIBRETRO_FCEUMM
	bool "libretro-fceumm"
	depends on (BR2_arm && BR2_ARM_EABIHF) || BR2_PACKAGE_RSOS_LIBRETRO_ARCH_SUPPORTS
	depends on !BR2_STATIC_LIBS # shared object loaded with dlopen()
	help
	  FCEUmm: NES / Famicom / Famicom Disk System emulator, built
	  as a libretro core.

	  Installs /usr/lib/libretro/fceumm_libretro.so and the
	  RetroStoneOS metadata file /usr/share/rsos/cores/fceumm.ini.

	  https://github.com/libretro/libretro-fceumm

comment "libretro-fceumm needs a toolchain w/ dynamic library"
	depends on (BR2_arm && BR2_ARM_EABIHF) || BR2_PACKAGE_RSOS_LIBRETRO_ARCH_SUPPORTS
	depends on BR2_STATIC_LIBS
```

## buildroot-external/package/libretro-fuse/Config.in
```kconfig
config BR2_PACKAGE_LIBRETRO_FUSE
	bool "libretro-fuse"
	depends on BR2_PACKAGE_RSOS_LIBRETRO_ARCH_SUPPORTS # package/libretro-common.mk
	depends on !BR2_STATIC_LIBS # shared object loaded with dlopen()
	help
	  Fuse, the Free Unix Spectrum Emulator: ZX Spectrum 16K/48K/
	  128K/+2/+2A/+3, Timex and Pentagon models, built as a libretro
	  core. The Spectrum ROMs are built in (Amstrad allows their
	  distribution with emulators). Has its own on-screen keyboard.

	  Installs /usr/lib/libretro/fuse_libretro.so and
	  /usr/share/rsos/cores/fuse.ini. ROM folder: zxspectrum.

	  https://github.com/libretro/fuse-libretro
```

## buildroot-external/package/libretro-gambatte/Config.in
```kconfig
config BR2_PACKAGE_LIBRETRO_GAMBATTE
	bool "libretro-gambatte"
	depends on BR2_PACKAGE_RSOS_LIBRETRO_ARCH_SUPPORTS # package/libretro-common.mk
	depends on BR2_INSTALL_LIBSTDCPP
	depends on !BR2_STATIC_LIBS # shared object loaded with dlopen()
	help
	  Gambatte: accurate Game Boy / Game Boy Color emulator, built
	  as a libretro core.

	  Installs /usr/lib/libretro/gambatte_libretro.so and
	  /usr/share/rsos/cores/gambatte.ini.

	  https://github.com/libretro/gambatte-libretro

comment "libretro-gambatte needs a toolchain w/ C++, dynamic library"
	depends on BR2_PACKAGE_RSOS_LIBRETRO_ARCH_SUPPORTS
	depends on !BR2_INSTALL_LIBSTDCPP || BR2_STATIC_LIBS
```
