## buildroot-external/package/libretro-gearboy/Config.in
```kconfig
config BR2_PACKAGE_LIBRETRO_GEARBOY
	bool "libretro-gearboy"
	depends on BR2_PACKAGE_RSOS_LIBRETRO_ARCH_SUPPORTS # package/libretro-common.mk
	depends on BR2_INSTALL_LIBSTDCPP
	depends on !BR2_STATIC_LIBS # shared object loaded with dlopen()
	help
	  Gearboy: Game Boy / Game Boy Color emulator, built as a libretro
	  core (GPL-3.0). Optional per-game alternative to gambatte.

	  Installs /usr/lib/libretro/gearboy_libretro.so and
	  /usr/share/rsos/cores/gearboy.ini.

	  https://github.com/drhelius/Gearboy

comment "libretro-gearboy needs a toolchain w/ C++, dynamic library"
	depends on BR2_PACKAGE_RSOS_LIBRETRO_ARCH_SUPPORTS
	depends on !BR2_INSTALL_LIBSTDCPP || BR2_STATIC_LIBS
```

## buildroot-external/package/libretro-gearcoleco/Config.in
```kconfig
config BR2_PACKAGE_LIBRETRO_GEARCOLECO
	bool "libretro-gearcoleco"
	depends on BR2_PACKAGE_RSOS_LIBRETRO_ARCH_SUPPORTS # package/libretro-common.mk
	depends on BR2_INSTALL_LIBSTDCPP
	depends on !BR2_STATIC_LIBS # shared object loaded with dlopen()
	help
	  Gearcoleco: ColecoVision (and Coleco ADAM) emulator, built as a
	  libretro core (GPL-3.0). Needs the ColecoVision BIOS
	  (colecovision.rom).

	  Installs /usr/lib/libretro/gearcoleco_libretro.so and
	  /usr/share/rsos/cores/gearcoleco.ini.

	  https://github.com/drhelius/Gearcoleco

comment "libretro-gearcoleco needs a toolchain w/ C++, dynamic library"
	depends on BR2_PACKAGE_RSOS_LIBRETRO_ARCH_SUPPORTS
	depends on !BR2_INSTALL_LIBSTDCPP || BR2_STATIC_LIBS
```

## buildroot-external/package/libretro-gearsystem/Config.in
```kconfig
config BR2_PACKAGE_LIBRETRO_GEARSYSTEM
	bool "libretro-gearsystem"
	depends on BR2_PACKAGE_RSOS_LIBRETRO_ARCH_SUPPORTS # package/libretro-common.mk
	depends on BR2_INSTALL_LIBSTDCPP
	depends on !BR2_STATIC_LIBS # shared object loaded with dlopen()
	help
	  Gearsystem: Sega Master System / Game Gear / SG-1000 emulator,
	  built as a libretro core (GPL-3.0). A licence-clean alternative
	  to picodrive for the 8-bit Sega systems.

	  Installs /usr/lib/libretro/gearsystem_libretro.so and
	  /usr/share/rsos/cores/gearsystem.ini.

	  https://github.com/drhelius/Gearsystem

comment "libretro-gearsystem needs a toolchain w/ C++, dynamic library"
	depends on BR2_PACKAGE_RSOS_LIBRETRO_ARCH_SUPPORTS
	depends on !BR2_INSTALL_LIBSTDCPP || BR2_STATIC_LIBS
```

## buildroot-external/package/libretro-geolith/Config.in
```kconfig
config BR2_PACKAGE_LIBRETRO_GEOLITH
	bool "libretro-geolith (experimental)"
	depends on (BR2_arm && BR2_ARM_EABIHF) || BR2_PACKAGE_RSOS_LIBRETRO_ARCH_SUPPORTS
	depends on !BR2_STATIC_LIBS # shared object loaded with dlopen()
	select BR2_PACKAGE_ZLIB
	help
	  Geolith: accurate Neo Geo AES / MVS / CD emulator, built as a
	  libretro core (BSD-3-Clause). Experimental licence-clean
	  alternative to fbneo for Neo Geo: cartridges must be in the
	  .neo format, and the BIOS zips of a recent MAME set are needed
	  (aes.zip, neogeo.zip, neocdz.zip). Speed on the 1 GHz A20 not
	  measured yet.

	  Installs /usr/lib/libretro/geolith_libretro.so and
	  /usr/share/rsos/cores/geolith.ini.

	  https://github.com/libretro/geolith-libretro

comment "libretro-geolith needs a toolchain w/ dynamic library"
	depends on (BR2_arm && BR2_ARM_EABIHF) || BR2_PACKAGE_RSOS_LIBRETRO_ARCH_SUPPORTS
	depends on BR2_STATIC_LIBS
```

## buildroot-external/package/libretro-gpsp/Config.in
```kconfig
config BR2_PACKAGE_LIBRETRO_GPSP
	bool "libretro-gpsp"
	depends on BR2_PACKAGE_RSOS_LIBRETRO_ARCH_SUPPORTS # package/libretro-common.mk
	depends on BR2_INSTALL_LIBSTDCPP # a few .cc files (no libstdc++ at run time)
	depends on !BR2_STATIC_LIBS # shared object loaded with dlopen()
	help
	  gpSP: Game Boy Advance emulator with an ARM dynamic recompiler,
	  built as a libretro core. Ships an open-source replacement
	  BIOS; the official gba_bios.bin is used when present.

	  Installs /usr/lib/libretro/gpsp_libretro.so and
	  /usr/share/rsos/cores/gpsp.ini.

	  https://github.com/libretro/gpsp

comment "libretro-gpsp needs a toolchain w/ C++, dynamic library"
	depends on BR2_PACKAGE_RSOS_LIBRETRO_ARCH_SUPPORTS
	depends on !BR2_INSTALL_LIBSTDCPP || BR2_STATIC_LIBS
```

## buildroot-external/package/libretro-handy/Config.in
```kconfig
config BR2_PACKAGE_LIBRETRO_HANDY
	bool "libretro-handy"
	depends on (BR2_arm && BR2_ARM_EABIHF) || BR2_PACKAGE_RSOS_LIBRETRO_ARCH_SUPPORTS
	depends on BR2_INSTALL_LIBSTDCPP
	depends on !BR2_STATIC_LIBS # shared object loaded with dlopen()
	help
	  Handy: Atari Lynx emulator, built as a libretro core (zlib
	  licence, with LGPL/GPL Blip_Buffer sound code). The Lynx boot
	  ROM is optional (HLE boot otherwise).

	  Installs /usr/lib/libretro/handy_libretro.so and
	  /usr/share/rsos/cores/handy.ini.

	  https://github.com/libretro/libretro-handy

comment "libretro-handy needs a toolchain w/ C++, dynamic library"
	depends on (BR2_arm && BR2_ARM_EABIHF) || BR2_PACKAGE_RSOS_LIBRETRO_ARCH_SUPPORTS
	depends on !BR2_INSTALL_LIBSTDCPP || BR2_STATIC_LIBS
```
