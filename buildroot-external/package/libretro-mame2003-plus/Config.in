## buildroot-external/package/rsos-freedoom/Config.in
```kconfig
config BR2_PACKAGE_RSOS_FREEDOOM
	bool "rsos-freedoom"
	depends on BR2_PACKAGE_RSOS_HOMEBREW # rsos-seed-homebrew copies the games
	help
	  Freedoom (https://freedoom.github.io/), a complete free game
	  for Doom engines (BSD-3-Clause), pre-installed so that the
	  "doom" system plays out of the box with libretro-prboom.

	  Installs the IWADs to /usr/share/rsos/homebrew/doom/ with a
	  gamelist.xml, and the licence and credits to
	  /usr/share/rsos/licenses/freedoom/. rsos-seed-homebrew
	  (rsos-homebrew) copies them to /data/roms/doom/ on the first
	  boot. About 28 MB per phase in the root filesystem (and again
	  on the data partition).

	  See docs/homebrew.md.

if BR2_PACKAGE_RSOS_FREEDOOM

config BR2_PACKAGE_RSOS_FREEDOOM_PHASE1
	bool "Freedoom: Phase 1 (freedoom1.wad)"
	default y
	help
	  Four episodes, compatible with Doom / The Ultimate Doom
	  PWADs.

config BR2_PACKAGE_RSOS_FREEDOOM_PHASE2
	bool "Freedoom: Phase 2 (freedoom2.wad)"
	default y
	help
	  32 levels, compatible with Doom II / Final Doom PWADs.

endif

comment "rsos-freedoom needs rsos-homebrew (first-boot seeding)"
	depends on !BR2_PACKAGE_RSOS_HOMEBREW
```

## buildroot-external/package/rsos-frontend/Config.in
```kconfig
config BR2_PACKAGE_RSOS_FRONTEND
	bool "rsos-frontend"
	depends on BR2_TOOLCHAIN_HAS_THREADS # libdrm, alsa-lib, transfer threads
	depends on !BR2_STATIC_LIBS # dlopen() of the libretro cores and of EGL/GLES
	select BR2_PACKAGE_LIBDRM
	select BR2_PACKAGE_ALSA_LIB
	select BR2_PACKAGE_ALSA_LIB_PCM
	# rsos-update, the system updater (docs/updates.md): zstd payloads,
	# HTTPS to GitHub (mbedTLS + the CA bundle)
	select BR2_PACKAGE_ZSTD
	select BR2_PACKAGE_MBEDTLS
	select BR2_PACKAGE_CA_CERTIFICATES
	help
	  RetroStoneOS frontend: the menu (EmulationStation-style UI and
	  theme engine), the KMS display layer (live LCD/HDMI switching,
	  hardware-scaled planes), the libretro host (one process per
	  game), input, power management and ROM transfer.

	  Also rsos-update, the system updater (docs/updates.md), run by
	  the menu as a helper process: it alone links zstd and mbedTLS,
	  so the menu's start-up is not slowed down by them.

	  When enabled, init starts /usr/bin/rsos-frontend (respawned):
	  post-build.sh adds the inittab line when the binary exists.

	  Installs to /usr/bin:
	  - rsos-frontend: the menu; "rsos-frontend --run ..." is the
	    game process it starts for each game;
	  - rsos-run: the same libretro host as a stand-alone tool;
	  - rsos-bootreason, rsos-clock: init helpers (charge-mode boot
	    detection, clock save/restore);
	  - rsos-kmstest, rsos-display-selftest: display bring-up tools.

	  And /usr/share/rsos/{fonts,themes,remaps,coreopts,web},
	  gamecontrollerdb.txt, data-README.txt and /etc/rsos-version.

	  EGL, GLES2 and GBM (mesa3d) are only needed at build time for
	  their headers: HW-rendered cores (N64) dlopen() them at run time.

if BR2_PACKAGE_RSOS_FRONTEND

config BR2_PACKAGE_RSOS_FRONTEND_SPLASH_BG
	string "boot logo background colour"
	default "2a2a35"
	help
	  Background of the boot logo (/usr/share/rsos/splash.rle), as
	  RRGGBB. Previews: docs/ui-previews/splash-*.png (000000,
	  16161c, 2a2a35, 16191e, e6e6ea, ffffff).

endif

comment "rsos-frontend needs a toolchain w/ threads, dynamic library"
	depends on !BR2_TOOLCHAIN_HAS_THREADS || BR2_STATIC_LIBS
```

## buildroot-external/package/rsos-homebrew/Config.in
```kconfig
config BR2_PACKAGE_RSOS_HOMEBREW
	bool "rsos-homebrew (first-boot seeding of the bundled games)"
	help
	  /usr/bin/rsos-seed-homebrew: on the first boot, copies the
	  games that packages put in /usr/share/rsos/homebrew/<system>/
	  (ROMs, gamelist.xml, media/) to /data/roms/<system>/, never
	  overwriting a file and merging gamelist.xml.

	  The games come from their own packages: rsos-ucity (µCity,
	  gbc), rsos-freedoom (doom), libretro-nxengine's optional Cave
	  Story data. See docs/homebrew.md.

source "$BR2_EXTERNAL_RETROSTONE_PATH/package/rsos-homebrew/rsos-homebrew-open/Config.in"
```

## buildroot-external/package/rsos-homebrew/rsos-homebrew-open/Config.in
```kconfig
config BR2_PACKAGE_RSOS_HOMEBREW_OPEN
	bool "rsos-homebrew-open (open-licence supplement)"
	depends on BR2_PACKAGE_RSOS_HOMEBREW # rsos-seed-homebrew
	help
	  Optional supplement of open-licence homebrew games for the
	  systems that have no game in the approved set (SNES, GBA,
	  Master System, Game Gear, PS1, arcade). Downloaded from the
	  authors' releases and checked against
	  rsos-homebrew-open.hash. Default off until the owner has
	  reviewed the list in docs/homebrew.md.

	  The game list is still empty: the research is not finished.
```

## buildroot-external/package/rsos-ucity/Config.in
```kconfig
config BR2_PACKAGE_RSOS_UCITY
	bool "rsos-ucity"
	depends on BR2_PACKAGE_RSOS_HOMEBREW # rsos-seed-homebrew copies the game
	help
	  µCity 1.2 (Antonio Niño Díaz), an open-source city builder
	  for the Game Boy Color, pre-installed so that the "gbc"
	  system has a game out of the box. Code GPL-3.0+, GBT Player
	  BSD-2-Clause, graphics and music CC BY-SA 4.0.

	  Downloads the upstream v1.2 release ROM and the source of the
	  tag (for "make legal-info"), both hash-checked. Installs the
	  ROM to /usr/share/rsos/homebrew/gbc/ with a gamelist.xml, and
	  the licences and NOTICE to /usr/share/rsos/licenses/ucity/.
	  rsos-seed-homebrew (rsos-homebrew) copies the game to
	  /data/roms/gbc/ on the first boot. 128 KB.

	  https://github.com/AntonioND/ucity
	  See docs/homebrew.md.

comment "rsos-ucity needs rsos-homebrew (first-boot seeding)"
	depends on !BR2_PACKAGE_RSOS_HOMEBREW
```

## buildroot-external/package/rsos-vc-games/Config.in
```kconfig
config BR2_PACKAGE_RSOS_VC_GAMES
	bool "rsos-vc-games"
	depends on !BR2_STATIC_LIBS # libretro cores, loaded with dlopen()
	help
	  The seven RetroStone VC games (8BCraft), the "RetroStone"
	  system at the start of the menu's carousel (docs/vc-games.md).

	  Each game is a libretro core built from the RetroStone VC
	  source (https://github.com/PaddleStroke/RetroStoneVC): the
	  SDK, the tools and the game code are MIT; the games' art,
	  music, sound, levels and design are CC BY-NC-SA 4.0. The game
	  is inside the core, there is no ROM.
	  Installs:
	  - /usr/lib/libretro/<game>_libretro.so and
	    /usr/share/rsos/cores/<game>.ini (no_content = true);
	  - /usr/share/rsos/games/retrostone/: one menu entry per game
	    ("Bomber Mole.bombermole", a stub file the host never
	    reads), gamelist.xml and media/images/ (title screens);
	  - /usr/share/rsos/licenses/retrostone-vc/.

	  "make legal-info" saves the source (the synced checkout).
	  The build needs python3 with Pillow on the build host
	  (python3-pil) for the games' asset step.

# Defined even when the package is disabled: the .mk sets the local SITE from
# it at parse time, and Buildroot parses every package .mk.
config BR2_PACKAGE_RSOS_VC_GAMES_SOURCE_DIR
	string "RetroStone VC checkout"
	default "$(BR2_EXTERNAL_RETROSTONE_PATH)/../../RetroStoneVC"
	help
	  The RetroStone VC repository (sdk/, games/, Makefile): by
	  default a checkout next to the RetroStoneOS one. CI checks
	  out the public PaddleStroke/RetroStoneVC and sets this path
	  (scripts/ci/build-board.sh, docs/ci.md). The build copies it
	  without build/, dist/, the art inbox and .git.

if BR2_PACKAGE_RSOS_VC_GAMES

config BR2_PACKAGE_RSOS_VC_GAMES_BOMBERMOLE
	bool "Bomber Mole"
	default y
	help
	  A mole who drops bombs to open the way, on three depths at
	  once, through four seasons. 1 player.

config BR2_PACKAGE_RSOS_VC_GAMES_LEADYSQUID
	bool "Leady Squid"
	default y
	help
	  A one-button "flap" game: a squid with too many lead weights
	  swims through the gaps of a sunken world. 1-4 players.

config BR2_PACKAGE_RSOS_VC_GAMES_DUCKPARADE
	bool "Duck Parade"
	default y
	help
	  Guide a family of ducks through ponds, roads and rivers. Up to
	  four parents cooperate to bring the ducklings home.

config BR2_PACKAGE_RSOS_VC_GAMES_BLUEBERRYTUMBLE
	bool "Blueberry Tumble"
	default y
	help
	  Roll a blueberry down a changing mountain landscape. Dodge
	  obstacles, collect dew and race with up to four players.

config BR2_PACKAGE_RSOS_VC_GAMES_BEAVERRUSH
	bool "Beaver Rush"
	default y
	help
	  Chop trees, dodge hazards and build your score. A fast arcade
	  challenge for one player or a race for up to four.

config BR2_PACKAGE_RSOS_VC_GAMES_PANCAKETOWER
	bool "Pancake Tower"
	default y
	help
	  Stack falling pancakes as precisely as possible, from the
	  kitchen to outer space. Build the tallest tower in solo play
	  or compete with up to four chefs.

config BR2_PACKAGE_RSOS_VC_GAMES_POGOMAMIE
	bool "Pogo Mamie"
	default y
	help
	  Bounce across the rooftops of Paris on a pogo stick. Avoid
	  aerial hazards, stomp pigeons and race with up to four
	  grannies.

endif

comment "rsos-vc-games needs a toolchain w/ dynamic library"
	depends on BR2_STATIC_LIBS
```
