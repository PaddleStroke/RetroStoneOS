## buildroot-external/package/libretro-mame2003-plus/Config.in
```kconfig
config BR2_PACKAGE_LIBRETRO_MAME2003_PLUS
	bool "libretro-mame2003-plus"
	depends on BR2_PACKAGE_RSOS_LIBRETRO_ARCH_SUPPORTS # package/libretro-common.mk
	depends on !BR2_STATIC_LIBS # shared object loaded with dlopen()
	help
	  MAME 2003-Plus: arcade emulator based on MAME 0.78 with many
	  later drivers and fixes backported, built as a libretro core.
	  Uses its own romset (MAME 0.78 plus additions, see
	  metadata/mame2003-plus.xml upstream). About 28 MB once
	  stripped.

	  Installs /usr/lib/libretro/mame2003_plus_libretro.so and
	  /usr/share/rsos/cores/mame2003_plus.ini.

	  https://github.com/libretro/mame2003-plus-libretro

comment "libretro-mame2003-plus needs a toolchain w/ dynamic library"
	depends on BR2_PACKAGE_RSOS_LIBRETRO_ARCH_SUPPORTS
	depends on BR2_STATIC_LIBS
```

## buildroot-external/package/libretro-mupen64plus-next/Config.in
```kconfig
config BR2_PACKAGE_LIBRETRO_MUPEN64PLUS_NEXT
	bool "libretro-mupen64plus-next (experimental)"
	depends on BR2_PACKAGE_RSOS_LIBRETRO_ARCH_SUPPORTS # package/libretro-common.mk
	depends on BR2_PACKAGE_HAS_LIBGLES # GLES2 hardware rendering
	depends on BR2_PACKAGE_HAS_LIBEGL # GLideN64 uses eglGetProcAddress()
	depends on BR2_INSTALL_LIBSTDCPP
	depends on BR2_TOOLCHAIN_HAS_THREADS
	depends on !BR2_STATIC_LIBS # shared object loaded with dlopen()
	help
	  Mupen64Plus-Next: Nintendo 64 emulator with the GLideN64
	  renderer, built as a GLES2 libretro core (same recipe as the
	  Raspberry Pi 2 Mesa build): ARM ari64 dynarec, NEON, GLES2.

	  Experimental on Mali-400 / lima: GLideN64's GLES2 path is
	  kept upstream but gets little testing, its shaders run at
	  fp16 (mediump) on Utgard, and it is heavier than the
	  glide64/gln64 renderers of libretro-parallel-n64, which is the
	  recommended N64 core. Useful as a per-game alternative.

	  Installs /usr/lib/libretro/mupen64plus_next_libretro.so and
	  /usr/share/rsos/cores/mupen64plus_next.ini.

	  https://github.com/libretro/mupen64plus-libretro-nx

comment "libretro-mupen64plus-next needs OpenGL ES and EGL providers, a toolchain w/ C++, threads, dynamic library"
	depends on BR2_PACKAGE_RSOS_LIBRETRO_ARCH_SUPPORTS
	depends on !BR2_PACKAGE_HAS_LIBGLES || !BR2_PACKAGE_HAS_LIBEGL || \
		!BR2_INSTALL_LIBSTDCPP || !BR2_TOOLCHAIN_HAS_THREADS || \
		BR2_STATIC_LIBS
```

## buildroot-external/package/libretro-nxengine/Config.in
```kconfig
config BR2_PACKAGE_LIBRETRO_NXENGINE
	bool "libretro-nxengine"
	depends on BR2_PACKAGE_RSOS_LIBRETRO_ARCH_SUPPORTS # package/libretro-common.mk
	depends on BR2_INSTALL_LIBSTDCPP
	depends on !BR2_STATIC_LIBS # shared object loaded with dlopen()
	help
	  NXEngine: an open-source (GPL-3.0) re-implementation of the
	  Cave Story engine, built as a libretro core. It runs the
	  freeware Cave Story 1.0.0.6 with the Aeon Genesis English
	  translation (Doukutsu.exe + data/).

	  Installs /usr/lib/libretro/nxengine_libretro.so and
	  /usr/share/rsos/cores/nxengine.ini. ROM folder: cavestory.

	  https://github.com/libretro/nxengine-libretro

config BR2_PACKAGE_LIBRETRO_NXENGINE_CAVESTORY
	bool "pre-install the freeware Cave Story"
	depends on BR2_PACKAGE_LIBRETRO_NXENGINE
	depends on BR2_PACKAGE_RSOS_HOMEBREW # rsos-seed-homebrew copies it
	help
	  Pre-install Cave Story (Studio Pixel, 2004, freeware; English
	  translation by Aeon Genesis), from the datafiles/ folder of
	  the nxengine-libretro source. It goes to
	  /usr/share/rsos/homebrew/cavestory/ (about 5 MB) and
	  rsos-seed-homebrew copies it to /data/roms/cavestory/ on the
	  first boot. The Windows tools shipped next to it (DoConfig.exe,
	  OrgView.exe) are left out.

	  Off by default: Cave Story is freeware, not free software. Its
	  readme says "This program is freeware" and grants no written
	  licence; it has been redistributed freely since 2004 and the
	  libretro project ships these files with the core, but the
	  bundled-games rule (docs/homebrew.md) asks for a licence or
	  permission that covers a commercial product. Owner decision.

comment "libretro-nxengine needs a toolchain w/ C++, dynamic library"
	depends on BR2_PACKAGE_RSOS_LIBRETRO_ARCH_SUPPORTS
	depends on !BR2_INSTALL_LIBSTDCPP || BR2_STATIC_LIBS
```

## buildroot-external/package/libretro-parallel-n64/Config.in
```kconfig
config BR2_PACKAGE_LIBRETRO_PARALLEL_N64
	bool "libretro-parallel-n64"
	# ARMv7 + NEON (ARM ari64 dynarec), or aarch64 / x86_64 (their dynarecs)
	depends on (BR2_arm && BR2_ARM_CPU_ARMV7A && BR2_ARM_CPU_HAS_NEON && BR2_ARM_EABIHF) || \
		BR2_aarch64 || BR2_x86_64
	depends on BR2_PACKAGE_HAS_LIBGLES # GLES2 hardware rendering
	depends on BR2_INSTALL_LIBSTDCPP
	depends on BR2_TOOLCHAIN_HAS_THREADS
	depends on !BR2_STATIC_LIBS # shared object loaded with dlopen()
	help
	  ParaLLEl-N64: Nintendo 64 emulator (Mupen64Plus fork), built
	  as a GLES2 libretro core for Mali-400 class GPUs: ARM ari64
	  dynarec, NEON, HLE RSP, and the light GLES2 renderers glide64,
	  gln64 (gles2n64) and rice (GLideN64 needs GLES3 in this core
	  and is left out; angrylion is software and far too slow;
	  paraLLEl-RDP needs Vulkan).

	  RetroStoneOS patch 0001 adds two core options: Count Per Op
	  (parallel-n64-CountPerOp) and a display-list frameskip for the
	  GL renderers (parallel-n64-frameskip, with an "auto" mode driven
	  by the frontend's audio buffer).

	  Requires a frontend that implements
	  RETRO_ENVIRONMENT_SET_HW_RENDER with a GLES2 context. Only a
	  subset of games is playable on a dual Cortex-A7; see
	  docs/cores.md.

	  Installs /usr/lib/libretro/parallel_n64_libretro.so and
	  /usr/share/rsos/cores/parallel_n64.ini.

	  https://github.com/libretro/parallel-n64

comment "libretro-parallel-n64 needs an OpenGL ES provider, a toolchain w/ C++, threads, dynamic library"
	depends on (BR2_arm && BR2_ARM_CPU_ARMV7A && BR2_ARM_CPU_HAS_NEON && BR2_ARM_EABIHF) || \
		BR2_aarch64 || BR2_x86_64
	depends on !BR2_PACKAGE_HAS_LIBGLES || !BR2_INSTALL_LIBSTDCPP || \
		!BR2_TOOLCHAIN_HAS_THREADS || BR2_STATIC_LIBS
```

## buildroot-external/package/libretro-pcsx-rearmed/Config.in
```kconfig
config BR2_PACKAGE_LIBRETRO_PCSX_REARMED
	bool "libretro-pcsx-rearmed"
	depends on BR2_PACKAGE_RSOS_LIBRETRO_ARCH_SUPPORTS # package/libretro-common.mk
	depends on BR2_TOOLCHAIN_HAS_THREADS
	depends on !BR2_STATIC_LIBS # shared object loaded with dlopen()
	help
	  PCSX ReARMed: Sony PlayStation emulator optimised for ARM, built
	  as a libretro core with the ari64 ARM dynarec (compiling on a
	  second thread) and the NEON software GPU. Uses a HLE BIOS when
	  no real BIOS file is found.

	  Installs /usr/lib/libretro/pcsx_rearmed_libretro.so and
	  /usr/share/rsos/cores/pcsx_rearmed.ini.

	  https://github.com/libretro/pcsx_rearmed

comment "libretro-pcsx-rearmed needs a toolchain w/ threads, dynamic library"
	depends on BR2_PACKAGE_RSOS_LIBRETRO_ARCH_SUPPORTS
	depends on !BR2_TOOLCHAIN_HAS_THREADS || BR2_STATIC_LIBS
```

## buildroot-external/package/libretro-picodrive/Config.in
```kconfig
config BR2_PACKAGE_LIBRETRO_PICODRIVE
	bool "libretro-picodrive"
	depends on BR2_PACKAGE_RSOS_LIBRETRO_ARCH_SUPPORTS # package/libretro-common.mk
	depends on !BR2_STATIC_LIBS # shared object loaded with dlopen()
	help
	  PicoDrive: Sega Mega Drive / Genesis, Master System, Game Gear,
	  SG-1000, 32X, Mega-CD / Sega CD and Pico emulator, built as a
	  libretro core with its ARM paths: Cyclone 68000 and DrZ80 asm
	  CPU cores, SH-2 and SSP160x (SVP) dynarecs, and ARM asm
	  renderers and sound mixers.

	  Installs /usr/lib/libretro/picodrive_libretro.so and
	  /usr/share/rsos/cores/picodrive.ini.

	  https://github.com/libretro/picodrive

comment "libretro-picodrive needs a toolchain w/ dynamic library"
	depends on BR2_PACKAGE_RSOS_LIBRETRO_ARCH_SUPPORTS
	depends on BR2_STATIC_LIBS
```

## buildroot-external/package/libretro-pokemini/Config.in
```kconfig
config BR2_PACKAGE_LIBRETRO_POKEMINI
	bool "libretro-pokemini"
	depends on BR2_PACKAGE_RSOS_LIBRETRO_ARCH_SUPPORTS # package/libretro-common.mk
	depends on !BR2_STATIC_LIBS # shared object loaded with dlopen()
	help
	  PokeMini: Pokemon mini emulator, built as a libretro core.
	  Uses its free replacement BIOS unless bios.min is in the
	  system directory.

	  Installs /usr/lib/libretro/pokemini_libretro.so and
	  /usr/share/rsos/cores/pokemini.ini. ROM folder: pokemini.

	  https://github.com/libretro/PokeMini
```

## buildroot-external/package/libretro-prboom/Config.in
```kconfig
config BR2_PACKAGE_LIBRETRO_PRBOOM
	bool "libretro-prboom"
	depends on BR2_PACKAGE_RSOS_LIBRETRO_ARCH_SUPPORTS # package/libretro-common.mk
	depends on BR2_TOOLCHAIN_HAS_THREADS # rthreads (libretro-common)
	depends on !BR2_STATIC_LIBS # shared object loaded with dlopen()
	help
	  PrBoom: the Doom engine (Doom, Doom II, Final Doom, Freedoom
	  and PWADs), built as a libretro core. prboom.wad (the
	  engine's own resources) is compiled into the core.

	  Installs /usr/lib/libretro/prboom_libretro.so and
	  /usr/share/rsos/cores/prboom.ini. ROM folder: doom.
	  rsos-freedoom pre-installs the free Freedoom IWADs.

	  https://github.com/libretro/libretro-prboom

comment "libretro-prboom needs a toolchain w/ threads, dynamic library"
	depends on BR2_PACKAGE_RSOS_LIBRETRO_ARCH_SUPPORTS
	depends on !BR2_TOOLCHAIN_HAS_THREADS || BR2_STATIC_LIBS
```

## buildroot-external/package/libretro-prosystem/Config.in
```kconfig
config BR2_PACKAGE_LIBRETRO_PROSYSTEM
	bool "libretro-prosystem"
	depends on BR2_PACKAGE_RSOS_LIBRETRO_ARCH_SUPPORTS # package/libretro-common.mk
	depends on !BR2_STATIC_LIBS # shared object loaded with dlopen()
	help
	  ProSystem: Atari 7800 emulator, built as a libretro core
	  (GPL-2.0+). The 7800 BIOS is optional.

	  Installs /usr/lib/libretro/prosystem_libretro.so and
	  /usr/share/rsos/cores/prosystem.ini.

	  https://github.com/libretro/prosystem-libretro

comment "libretro-prosystem needs a toolchain w/ dynamic library"
	depends on BR2_PACKAGE_RSOS_LIBRETRO_ARCH_SUPPORTS
	depends on BR2_STATIC_LIBS
```

## buildroot-external/package/libretro-scummvm/Config.in
```kconfig
config BR2_PACKAGE_LIBRETRO_SCUMMVM
	bool "libretro-scummvm"
	depends on BR2_PACKAGE_RSOS_LIBRETRO_ARCH_SUPPORTS # package/libretro-common.mk
	depends on BR2_INSTALL_LIBSTDCPP
	depends on BR2_TOOLCHAIN_HAS_THREADS
	depends on BR2_TOOLCHAIN_GCC_AT_LEAST_8 # C++ 11/14 features
	depends on !BR2_STATIC_LIBS # shared object loaded with dlopen()
	help
	  ScummVM's own libretro port: point-and-click adventure and RPG
	  engines (SCUMM, AGI, SCI, Kyrandia, Broken Sword, Simon the
	  Sorcerer, Beneath a Steel Sky, ...). Built with the upstream
	  "lite" engine list (31 engines, docs/cores.md) and no OpenGL.
	  The pad moves the mouse cursor.

	  Installs /usr/lib/libretro/scummvm_libretro.so,
	  /usr/share/rsos/cores/scummvm.ini and the engine data files and
	  GUI theme in /usr/share/rsos/cores/scummvm/ (copied to the
	  libretro system directory). ROM folder: scummvm.

	  https://github.com/libretro/scummvm
	  https://www.scummvm.org/

comment "libretro-scummvm needs a toolchain w/ C++, threads, gcc >= 8, dynamic library"
	depends on BR2_PACKAGE_RSOS_LIBRETRO_ARCH_SUPPORTS
	depends on !BR2_INSTALL_LIBSTDCPP || !BR2_TOOLCHAIN_HAS_THREADS || \
		!BR2_TOOLCHAIN_GCC_AT_LEAST_8 || BR2_STATIC_LIBS
```

## buildroot-external/package/libretro-smsplus-gx/Config.in
```kconfig
config BR2_PACKAGE_LIBRETRO_SMSPLUS_GX
	bool "libretro-smsplus-gx"
	depends on BR2_PACKAGE_RSOS_LIBRETRO_ARCH_SUPPORTS # package/libretro-common.mk
	depends on !BR2_STATIC_LIBS # shared object loaded with dlopen()
	help
	  SMS Plus GX: light Sega Master System / Game Gear / SG-1000
	  (and ColecoVision) emulator, built as a libretro core
	  (GPL-2.0+). A licence-clean alternative to picodrive for the
	  8-bit Sega systems.

	  Installs /usr/lib/libretro/smsplus_libretro.so and
	  /usr/share/rsos/cores/smsplus.ini.

	  https://github.com/libretro/smsplus-gx

comment "libretro-smsplus-gx needs a toolchain w/ dynamic library"
	depends on BR2_PACKAGE_RSOS_LIBRETRO_ARCH_SUPPORTS
	depends on BR2_STATIC_LIBS
```

## buildroot-external/package/libretro-snes9x2005/Config.in
```kconfig
config BR2_PACKAGE_LIBRETRO_SNES9X2005
	bool "libretro-snes9x2005"
	depends on (BR2_arm && BR2_ARM_EABIHF) || BR2_PACKAGE_RSOS_LIBRETRO_ARCH_SUPPORTS
	depends on !BR2_STATIC_LIBS # shared object loaded with dlopen()
	help
	  Snes9x 2005 (Snes9x 1.43 based, formerly CATSFC): the fastest
	  Super Nintendo / Super Famicom core, less accurate than
	  snes9x2010 (older APU, no DSP-2/3/4 or MSU-1). Full speed on a
	  ~1 GHz Cortex-A7 including SuperFX and SA-1 games, which is
	  why it is the recommended default SNES core for RetroStoneOS.

	  Installs /usr/lib/libretro/snes9x2005_libretro.so and
	  /usr/share/rsos/cores/snes9x2005.ini.

	  https://github.com/libretro/snes9x2005

comment "libretro-snes9x2005 needs a toolchain w/ dynamic library"
	depends on (BR2_arm && BR2_ARM_EABIHF) || BR2_PACKAGE_RSOS_LIBRETRO_ARCH_SUPPORTS
	depends on BR2_STATIC_LIBS
```

## buildroot-external/package/libretro-snes9x2010/Config.in
```kconfig
config BR2_PACKAGE_LIBRETRO_SNES9X2010
	bool "libretro-snes9x2010"
	depends on BR2_PACKAGE_RSOS_LIBRETRO_ARCH_SUPPORTS # package/libretro-common.mk
	depends on BR2_TOOLCHAIN_HAS_THREADS
	depends on !BR2_STATIC_LIBS # shared object loaded with dlopen()
	help
	  Snes9x 2010 (Snes9x 1.52 based, formerly snes9x-next): Super
	  Nintendo / Super Famicom core. More accurate than snes9x2005
	  (blargg SPC700/DSP, more special chips, MSU-1) but slower:
	  SuperFX/SA-1 games drop below 60 fps on a ~1 GHz Cortex-A7.
	  Per-game alternative to snes9x2005 (see docs/cores.md).

	  Installs /usr/lib/libretro/snes9x2010_libretro.so and
	  /usr/share/rsos/cores/snes9x2010.ini.

	  https://github.com/libretro/snes9x2010

comment "libretro-snes9x2010 needs a toolchain w/ threads, dynamic library"
	depends on BR2_PACKAGE_RSOS_LIBRETRO_ARCH_SUPPORTS
	depends on !BR2_TOOLCHAIN_HAS_THREADS || BR2_STATIC_LIBS
```

## buildroot-external/package/libretro-stella2014/Config.in
```kconfig
config BR2_PACKAGE_LIBRETRO_STELLA2014
	bool "libretro-stella2014"
	depends on BR2_PACKAGE_RSOS_LIBRETRO_ARCH_SUPPORTS # package/libretro-common.mk
	depends on BR2_INSTALL_LIBSTDCPP
	depends on !BR2_STATIC_LIBS # shared object loaded with dlopen()
	help
	  Stella 2014: Atari 2600 emulator (Stella 3.9.3), built as a
	  libretro core (GPL-2.0).

	  Installs /usr/lib/libretro/stella2014_libretro.so and
	  /usr/share/rsos/cores/stella2014.ini.

	  https://github.com/libretro/stella2014-libretro

comment "libretro-stella2014 needs a toolchain w/ C++, dynamic library"
	depends on BR2_PACKAGE_RSOS_LIBRETRO_ARCH_SUPPORTS
	depends on !BR2_INSTALL_LIBSTDCPP || BR2_STATIC_LIBS
```

## buildroot-external/package/libretro-vice/Config.in
```kconfig
config BR2_PACKAGE_LIBRETRO_VICE
	bool "libretro-vice (x64)"
	depends on BR2_PACKAGE_RSOS_LIBRETRO_ARCH_SUPPORTS # package/libretro-common.mk
	depends on BR2_INSTALL_LIBSTDCPP # reSID
	depends on !BR2_STATIC_LIBS # shared object loaded with dlopen()
	help
	  VICE, the Versatile Commodore Emulator: its fast Commodore 64
	  emulator "x64" (not the cycle-exact x64sc), built as a libretro
	  core. The C64 and 1541 ROMs are built into the core by
	  upstream. Has its own on-screen keyboard.

	  Installs /usr/lib/libretro/vice_x64_libretro.so and
	  /usr/share/rsos/cores/vice_x64.ini. ROM folder: c64.

	  https://github.com/libretro/vice-libretro

comment "libretro-vice needs a toolchain w/ C++, dynamic library"
	depends on BR2_PACKAGE_RSOS_LIBRETRO_ARCH_SUPPORTS
	depends on !BR2_INSTALL_LIBSTDCPP || BR2_STATIC_LIBS
```
